## boards/KalScott/Kconfig.kestrel
```kconfig
# Copyright (c) 2024 Nordic Semiconductor
# SPDX-License-Identifier: LicenseRef-Nordic-5-Clause

config BOARD_KESTREL
	select SOC_NRF9151_LACA if BOARD_KESTREL || BOARD_KESTREL_NS
	
```

## boards/KalScott/Kconfig.sysbuild
```kconfig
# Copyright (c) 2024 Nordic Semiconductor ASA
# SPDX-License-Identifier: LicenseRef-Nordic-5-Clause

choice BOOTLOADER
	default BOOTLOADER_MCUBOOT if KESTREL_STATIC_PARTITIONS_FACTORY
endchoice

choice
	prompt "Pre-defined Thingy:91 X partition layout"
	default KESTREL_STATIC_PARTITIONS_FACTORY

config KESTREL_STATIC_PARTITIONS_FACTORY
	bool "Factory Thingy:91 X partition layout"
	help
	   The default Thingy:91 X partition layout used in the factory firmware. This ensures
	   firmware updates are compatible with Thingy:91 X when flashing firmware over USB or over
	   the air.

config KESTREL_NO_PREDEFINED_LAYOUT
	bool "None [EXPERIMENTAL]"
	select EXPERIMENTAL
	help
	   Disable pre-defined static partition layout. This allows the application to use a dynamic
	   layout or define a custom static partition layout for the application. A debugger is
	   needed to flash Thingy:91 with a different partition layout.

endchoice

if BOARD_KESTREL_NRF9151 || BOARD_KESTREL_NRF9151_NS

config SECURE_BOOT_APPCORE
	default y if KESTREL_STATIC_PARTITIONS_FACTORY

config PM_EXTERNAL_FLASH_MCUBOOT_SECONDARY
	default y if BOOTLOADER_MCUBOOT

config PM_OVERRIDE_EXTERNAL_DRIVER_CHECK
	default y if BOOTLOADER_MCUBOOT

config SECURE_BOOT_SIGNING_KEY_FILE
	default "C:/Nordic/myApps/key_file/mcu_sign.pem"

endif # BOARD_THINGY91X_NRF9151 || BOARD_THINGY91X_NRF9151_NS
```

## boards/KalScott/board.yml
```yaml
board:
  name: kestrel
  vendor: nordic
  socs:
    - name: nrf9151
      variants:
        - name: ns
```
